## Kconfig
```kconfig
config KORZ_CAPS_WORD
	bool "korz caps word: ZMK's caps word with a list of keys that stop it"
	default y
	depends on DT_HAS_KORZ_BEHAVIOR_CAPS_WORD_ENABLED
	# like ZMK's own: the halves of a split that are not the central have no key event or HID code
	depends on !ZMK_SPLIT || ZMK_SPLIT_ROLE_CENTRAL
	help
	  Used when the keymap sets compatible = "korz,behavior-caps-word" on &caps_word.

config KORZ_ACAP
	bool "korz &acap: a letter that is capital whatever the computer's Caps Lock state"
	default y
	depends on DT_HAS_KORZ_BEHAVIOR_ACAP_ENABLED
	depends on ZMK_HID_INDICATORS
	depends on !ZMK_SPLIT || ZMK_SPLIT_ROLE_CENTRAL

config KORZ_LAYER_TIMEOUT
	bool "Back to the default layer after a quiet period"
	depends on !ZMK_SPLIT || ZMK_SPLIT_ROLE_CENTRAL
	help
	  Quiet means no key, no layer change and no pointing input (joystick, air mouse).
	  Layers switched on (toggled, auto layers) are switched off; a held key is never cut off.

if KORZ_LAYER_TIMEOUT

config KORZ_LAYER_TIMEOUT_S
	int "Seconds of quiet before the layers are switched off"
	default 120
	range 5 86400

config KORZ_LAYER_TIMEOUT_KEEP_MASK
	hex "Layers that never time out (bit = layer number, 0x10 = layer 4, 0 = none)"
	default 0x0

config KORZ_LAYER_TIMEOUT_CAPS_WORD
	bool "The quiet period also ends caps word"
	default y
	depends on KORZ_CAPS_WORD

endif # KORZ_LAYER_TIMEOUT

config KORZ_HOLD_TAP
	bool "korz hold-tap: ZMK's hold-tap with its own list, so one can sit inside another"
	default y
	depends on DT_HAS_KORZ_BEHAVIOR_HOLD_TAP_ENABLED
	help
	  Used when the keymap sets compatible = "korz,behavior-hold-tap" on a hold-tap that is
	  placed inside the tap binding of another hold-tap (same key position).

if KORZ_HOLD_TAP

config KORZ_HOLD_TAP_MAX_HELD
	int "Most korz hold-taps held at once"
	default 10

config KORZ_HOLD_TAP_MAX_CAPTURED_EVENTS
	int "Most key events a korz hold-tap keeps while it waits to decide"
	default 40

endif # KORZ_HOLD_TAP
```

## dts/bindings/korz,behavior-acap.yaml
```yaml
description: A letter that is always capital, even when the computer's Caps Lock is on

compatible: "korz,behavior-acap"

include: one_param.yaml

parameters:
  - name: key
    description: The letter (for example V). Other keys are sent as they are.
```

## dts/bindings/korz,behavior-caps-word.yaml
```yaml
# ZMK's caps word, plus stop-list (keys that end it even if they are modifiers) and keypad digits.
description: Caps word that can be stopped by chosen keys

compatible: "korz,behavior-caps-word"

include: zero_param.yaml

properties:
  continue-list:
    type: array
    required: true
    description: Keys that do not end caps word (as in ZMK's caps word)
  mods:
    type: int
    description: Modifiers added to the letters (default left shift)
  stop-list:
    type: array
    description: |
      Keys that end caps word, modifiers included. ZMK's caps word ignores modifier keys;
      list one here (for example LCTRL) to make it end caps word.
  keypad-numbers:
    type: boolean
    description: Keypad digits (KP_N0..KP_N9) continue caps word, like the number row
```
